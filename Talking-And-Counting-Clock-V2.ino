// Talking And Counting Clock by TUENHIDIY
// A voice data is referenced from Talkie library: https://github.com/ArminJo/Talkie/

#include <Adafruit_CircuitPlayground.h>
#include <Wire.h>
#include <SPI.h>
#include <RTClib.h>

#define EX_NEOPIX_PIN    A1
#define EX_NUM_PIXELS    35
#define IN_NUM_PIXELS    10

// Use Adafruit_CPlay_NeoPixel to define color for external NeoPixel strip

#define _RED                Adafruit_CPlay_NeoPixel::Color(255, 0, 0)           //    RED
#define _GREEN              Adafruit_CPlay_NeoPixel::Color(0, 255, 0)           //    GREEN
#define _BLUE               Adafruit_CPlay_NeoPixel::Color(0, 0, 255)           //    BLUE
#define _ORANGE             Adafruit_CPlay_NeoPixel::Color(255, 165, 0)         //    ORANGE
#define _YELLOW             Adafruit_CPlay_NeoPixel::Color(255, 255, 0)         //    YELLOW
#define _MAGENTA            Adafruit_CPlay_NeoPixel::Color(255, 0, 255)         //    MAGENTA
#define _PURPLE             Adafruit_CPlay_NeoPixel::Color(128, 0, 128)         //    PURPLE
#define _CYAN               Adafruit_CPlay_NeoPixel::Color(0, 255, 255)         //    CYAN
#define _PINK               Adafruit_CPlay_NeoPixel::Color(255, 192, 203)       //    PINK
#define _WHITE              Adafruit_CPlay_NeoPixel::Color(255, 255, 255)       //    WHITE
#define _BLACK              Adafruit_CPlay_NeoPixel::Color(0, 0, 0)             //    BLACK

// For Buit-in Neopixels color
uint32_t colors[] = 
{
  0xCD5C5C,   // IndianRed
  0xFF1493,   // DeepPink
  0xFF8C00,   // DarkOrange
  0xEE82EE,   // Violet
  0x800080,   // Purple
  0x32CD32,   // LimeGreen
  0x4682B4,   // SteelBlue
  0xBC8F8F,   // RosyBrown
  0x2F4F4F,   // DarkSlateGray
  0xBC8F8F    // RosyBrown
};

byte H0[5] = {15, 14, 13, 12, 11};                  // Minute - Ten digit
byte H1[9] = {10, 9, 8, 7, 6, 5, 4, 3, 2};          // Minute - Unit digit
byte M0[5] = {20, 21, 22, 23, 24};                  // Minute - Ten digit
byte M1[9] = {25, 26, 27, 28, 29, 30, 31, 32, 33};  // Minute - Unit digit
byte SEPERATOR[7] = {34, 0, 1, 16, 17, 18, 19};     // Seperator leds

byte H1_Number, H0_Number, M1_Number, M0_Number, SS_Number;
byte h0, h1, m0, m1, ss;
byte prveh0, prveh1, prvem0, prvem1, prvess;

unsigned long samplingtimeh0 = 0;
unsigned long samplingtimeh1 = 0;
unsigned long samplingtimem0 = 0;
unsigned long samplingtimem1 = 0;
unsigned long samplingtimess = 0;
unsigned long samplingtimese = 0;
unsigned long samplingtimesp = 0;

void DrawDot(byte number, byte coordinates[], byte maximum, uint32_t frontcolor);
void Effect_H0(uint32_t frontcolor);
void Effect_H1(uint32_t frontcolor);
void Effect_M0(uint32_t frontcolor);
void Effect_M1(uint32_t frontcolor);
void Effect_SS();
void Effect_SEP(uint32_t frontcolor);
void Effect_Speech();
int hour;
int mins;
int sec;
// Using Adafruit_CPlay_NeoPixel to create a separate external NeoPixel strip
Adafruit_CPlay_NeoPixel strip = Adafruit_CPlay_NeoPixel(EX_NUM_PIXELS, EX_NEOPIX_PIN, NEO_GRB + NEO_KHZ800);

// Female voice SP - Numbers and letters
const uint8_t spTHE[]       PROGMEM = {0x08,0xE8,0x3E,0x55,0x01,0xC3,0x86,0x27,0xAF,0x72,0x0D,0x4D,0x97,0xD5,0xBC,0x64,0x3C,0xF2,0x5C,0x51,0xF1,0x93,0x36,0x8F,0x4F,0x59,0x2A,0x42,0x7A,0x32,0xC3,0x64,0xFF,0x3F};
const uint8_t spTIME[]      PROGMEM = {0x0E,0x28,0xAC,0x2D,0x01,0x5D,0xB6,0x0D,0x33,0xF3,0x54,0xB3,0x60,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0xFF,0x07};
const uint8_t spIS[]        PROGMEM = {0x21,0x18,0x96,0x38,0xB7,0x14,0x8D,0x60,0x3A,0xA6,0xE8,0x51,0xB4,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0xFF,0x7F};
const uint8_t spA_M_[]      PROGMEM = {0xCD,0xEF,0x86,0xAB,0x57,0x6D,0x0F,0xAF,0x71,0xAD,0x49,0x55,0x3C,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0xFF,0x3F};
const uint8_t spP_M_[]      PROGMEM = {0x0E,0x98,0x41,0x54,0x00,0x43,0xA0,0x05,0xAB,0x42,0x8E,0x1D,0xA3,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0xFF,0x0F};
const uint8_t spOH[]        PROGMEM = {0xC6,0xC9,0x71,0x5A,0xA2,0x92,0x14,0x2F,0x6E,0x97,0x9C,0x46,0x9D,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0xFF,0x01};
const uint8_t spOCLOCK[]    PROGMEM = {0x21,0x4E,0x3D,0xB8,0x2B,0x19,0xBB,0x24,0x0E,0xE5,0xEC,0x60,0xE4,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0xFF,0x07};
const uint8_t spONE[]       PROGMEM = {0xCC,0x67,0x75,0x42,0x59,0x5D,0x3A,0x4F,0x9D,0x36,0x63,0xB7,0x59,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0xFF,0x0F};
const uint8_t spTWO[]       PROGMEM = {0x0E,0x38,0x6E,0x25,0x00,0xA3,0x0D,0x3A,0xA0,0x37,0xC5,0xA0,0x05,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0xFF,0x0F};
const uint8_t spTHREE[]     PROGMEM = {0x02,0xD8,0x2E,0x9C,0x01,0xDB,0xA6,0x33,0x60,0xFB,0x30,0x01,0xEC,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0xFF,0x0F};
const uint8_t spFOUR[]      PROGMEM = {0x0C,0x18,0xB6,0x9A,0x01,0xC3,0x75,0x09,0x60,0xD8,0x0E,0x09,0x30,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0xFF,0x07};
const uint8_t spFIVE[]      PROGMEM = {0x02,0xE8,0x3E,0x8C,0x01,0xDD,0x65,0x08,0x60,0x98,0x4C,0x06,0x34,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0xFE,0x7F};
const uint8_t spSIX[]       PROGMEM = {0x0E,0xD8,0xAE,0xDD,0x03,0x0E,0x38,0xA6,0xD2,0x01,0xD3,0xB4,0x2C,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0xFC,0x3F};
const uint8_t spSEVEN[]     PROGMEM = {0x02,0xB8,0x3A,0x8C,0x01,0xDF,0xA4,0x73,0x40,0x01,0x47,0xB9,0x2F,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0xF3,0xFF};
const uint8_t spEIGHT[]     PROGMEM = {0xC3,0x6C,0x86,0xB3,0x27,0x6D,0x0F,0xA7,0x48,0x99,0x4E,0x55,0x3C,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0xFE,0x1F};
const uint8_t spNINE[]      PROGMEM = {0xCC,0xA1,0x26,0xBB,0x83,0x93,0x18,0xCF,0x4A,0xAD,0x2E,0x31,0xED,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0xFF,0x07};
const uint8_t spTEN[]       PROGMEM = {0x0E,0xD8,0xB1,0xDD,0x01,0x3D,0xA8,0x24,0x7B,0x04,0x27,0x76,0x77,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0xFF,0x0F};
const uint8_t spELEVEN[]    PROGMEM = {0xC3,0xCD,0x76,0x5C,0xAE,0x14,0x0F,0x37,0x9B,0x71,0xDE,0x92,0x55,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0xFF,0x0F};
const uint8_t spTWELVE[]    PROGMEM = {0x06,0x28,0x46,0xD3,0x01,0x25,0x06,0x13,0x20,0xBA,0x70,0x70,0xB6,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0xFF,0x0F};
const uint8_t spTHIRTEEN[]  PROGMEM = {0x08,0xE8,0x2C,0x15,0x01,0x43,0x07,0x13,0xE0,0x98,0xB4,0xA6,0x35,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0xFF,0x01};
const uint8_t spFOURTEEN[]  PROGMEM = {0x0C,0x58,0xAE,0x5C,0x01,0xD9,0x87,0x07,0x51,0xB7,0x25,0xB3,0x8A,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0xF9,0xFF};
const uint8_t spFIFTEEN[]   PROGMEM = {0x08,0xE8,0x2A,0x0D,0x01,0xDD,0xBA,0x31,0x60,0x6A,0xF7,0xA0,0xAE,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0xFF,0x07};
const uint8_t spSIXTEEN[]   PROGMEM = {0x0A,0x58,0x5A,0x5D,0x00,0x93,0x97,0x0B,0x60,0xA9,0x48,0x05,0x0C,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0xFF,0x1F};
const uint8_t spSEVENTEEN[] PROGMEM = {0x02,0x98,0x3A,0x42,0x00,0x5B,0xA6,0x09,0x60,0xDB,0x52,0x06,0x1C,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0xFD,0x3F};
const uint8_t spEIGHTEEN[]  PROGMEM = {0x2E,0x9C,0xD1,0x4D,0x54,0xEC,0x2C,0xBF,0x1B,0x8A,0x99,0x70,0x7C,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0xF3,0xFF};
const uint8_t spNINETEEN[]  PROGMEM = {0xC2,0xEA,0x8A,0x95,0x2B,0x6A,0x05,0x3F,0x71,0x71,0x5F,0x0D,0x12,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0xFF,0x1F};
const uint8_t spTWENTY[]    PROGMEM = {0x01,0x98,0xD1,0xC2,0x00,0xCD,0xA4,0x32,0x20,0x79,0x13,0x04,0x28,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0xFF,0x0F};
const uint8_t spTHIRTY[]    PROGMEM = {0x08,0x98,0xD6,0x15,0x01,0x43,0xBB,0x0A,0x20,0x1B,0x8B,0xE5,0x16,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0xFF,0x01};
const uint8_t spFOURTY[]    PROGMEM = {0x04,0x18,0xB6,0x4C,0x00,0xC3,0x56,0x30,0xA0,0xE8,0xF4,0xA0,0x98,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0xFF,0x01};
const uint8_t spFIFTY[]     PROGMEM = {0x08,0xE8,0x2E,0x84,0x00,0x23,0x84,0x13,0x60,0x38,0x95,0xA5,0x0F,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0xFF,0x1F};
const uint8_t spGOOD[]      PROGMEM = {0x0A,0x28,0xCD,0x34,0x20,0xD9,0x1A,0x45,0x74,0xE4,0x66,0x24,0xAD,0xBA,0xB1,0x8C,0x9B,0x91,0xA5,0x64,0xE6,0x98,0x21,0x16,0x0B,0x96,0x9B,0x4C,0xE5,0xFF,0x01};
const uint8_t spMORNING[]   PROGMEM = {0xCE,0x08,0x52,0x2A,0x35,0x5D,0x39,0x53,0x29,0x5B,0xB7,0x0A,0x15,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0xFC,0xFF};
const uint8_t spAFTERNOON[] PROGMEM = {0xC7,0xCE,0xCE,0x3A,0xCB,0x58,0x1F,0x3B,0x07,0x9D,0x28,0x71,0xB4,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0xFF,0x03};
const uint8_t spEVENING[]   PROGMEM = {0xCD,0x6D,0x98,0x73,0x47,0x65,0x0D,0x6D,0x10,0xB2,0x5D,0x93,0x35,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0xFF,0x03};
const uint8_t spPAUSE1[]    PROGMEM = {0x00,0x00,0x00,0x00,0xFF,0x0F};

// Male voice SP2 - Numbers and letters

const uint8_t sp2_ZERO[] PROGMEM = {0x69,0xFB,0x59,0xDD,0x51,0xD5,0xD7,0xB5,0x6F,0x0A,0x78,0xC0,0x52,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0xFF,0x1F};
const uint8_t sp2_ONE[] PROGMEM = {0x66,0x4E,0xA8,0x7A,0x8D,0xED,0xC4,0xB5,0xCD,0x89,0xD4,0xBC,0xA2,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0xFE,0x1F};
const uint8_t sp2_TWO[] PROGMEM = {0x06,0xB8,0x59,0x34,0x00,0x27,0xD6,0x38,0x60,0x58,0xD3,0x91,0x55,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0xFF,0x1F};
const uint8_t sp2_THREE[] PROGMEM = {0x0C,0xE8,0x2E,0x94,0x01,0x4D,0xBA,0x4A,0x40,0x03,0x16,0x68,0x69,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0xFF,0x03};
const uint8_t sp2_FOUR[] PROGMEM = {0x08,0x68,0x21,0x0D,0x03,0x04,0x28,0xCE,0x92,0x03,0x23,0x4A,0xCA,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0xF2,0xFF};
const uint8_t sp2_FIVE[] PROGMEM = {0x08,0x68,0x4E,0x9D,0x02,0x1C,0x60,0xC0,0x8C,0x69,0x12,0xB0,0xC0,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0xFF,0x01};
const uint8_t sp2_SIX[] PROGMEM = {0x04,0xF8,0xAD,0x4C,0x02,0x16,0xB0,0x80,0x06,0x56,0x35,0x5D,0xA8,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0xFF,0x01};
const uint8_t sp2_SEVEN[] PROGMEM = {0x0C,0xF8,0x5E,0x4C,0x01,0xBF,0x95,0x7B,0xC0,0x02,0x16,0xB0,0xC0,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0xFB,0x7F};
const uint8_t sp2_EIGHT[] PROGMEM = {0x65,0x69,0x89,0xC5,0x73,0x66,0xDF,0xE9,0x8C,0x33,0x0E,0x41,0xC6,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0xF8,0x7F};
const uint8_t sp2_NINE[] PROGMEM = {0xE6,0xA8,0x1A,0x35,0x5D,0xD6,0x9A,0x35,0x4B,0x8C,0x4E,0x6B,0x1A,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0xFF,0x0F};
const uint8_t sp2_TEN[] PROGMEM = {0x0E,0x38,0x3C,0x2D,0x00,0x5F,0xB6,0x19,0x60,0xA8,0x90,0x93,0x36,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0xFF,0x03};
const uint8_t sp2_ELEVEN[] PROGMEM = {0xA5,0xEF,0xD6,0x50,0x3B,0x67,0x8F,0xB9,0x3B,0x23,0x49,0x7F,0x33,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0xFF,0x0F};
const uint8_t sp2_TWELVE[] PROGMEM = {0x09,0x98,0xDA,0x22,0x01,0x37,0x78,0x1A,0x20,0x85,0xD1,0x50,0x3A,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0xFE,0x1F};
const uint8_t sp2_THIR_[] PROGMEM = {0x04,0xA8,0xBE,0x5C,0x00,0xDD,0xA5,0x11,0xA0,0xFA,0x72,0x02,0x74,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0xFF,0x03};
const uint8_t sp2_FIF_[] PROGMEM = {0x08,0x98,0x31,0x93,0x02,0x1C,0xE0,0x80,0x07,0x5A,0xD6,0x1C,0x6B,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0xFC,0x3F};
const uint8_t sp2__TEEN[] PROGMEM = {0x09,0x58,0x2A,0x25,0x00,0xCB,0x9F,0x95,0x6C,0x14,0x21,0x89,0xA9,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0xFF,0x3F};
const uint8_t sp2_TWENTY[] PROGMEM = {0x0A,0xE8,0x4A,0xCD,0x01,0xDB,0xB9,0x33,0xC0,0xA6,0x54,0x0C,0xA4,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0xFF,0x1F};
const uint8_t sp2_HUNDRED[] PROGMEM = {0x04,0xC8,0x7E,0x5C,0x02,0x0A,0xA8,0x62,0x43,0x03,0xA7,0xA8,0x62,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0xF9,0x7F};
const uint8_t sp2_THOUSAND[] PROGMEM = {0x0C,0xE8,0x2E,0xD4,0x02,0x06,0x98,0xD2,0x55,0x03,0x16,0x68,0x7D,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0xFF,0x0F};

const uint8_t sp2_MINUS[] PROGMEM = {0xE6,0x28,0xC4,0xF8,0x44,0x9A,0xFB,0xCD,0xAD,0x8D,0x2A,0x4E,0x4A,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0xFF,0x03};
const uint8_t sp2_AND[] PROGMEM = {0xA9,0x6B,0x21,0xB9,0x22,0x66,0x9F,0xAE,0xC7,0xE1,0x70,0x7B,0x72,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0xFF,0x3F};
const uint8_t sp2_T[] PROGMEM = {0x01,0xD8,0xB6,0xDD,0x01,0x2F,0xF4,0x38,0x60,0xD5,0xD1,0x91,0x4D,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0xFF,0x07};
const uint8_t sp2_L[] PROGMEM = {0x6B,0x68,0x2E,0xD8,0x2A,0x37,0xDF,0xFE,0xF6,0xA7,0xAF,0x21,0xBC,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0xFF,0x0F};
const uint8_t sp2_X[] PROGMEM = {0xAD,0x68,0xC9,0xC5,0x32,0x56,0xDF,0xFA,0x54,0x2D,0x35,0x7B,0xF8,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0xFE,0x1F};
const uint8_t sp2_THE[] PROGMEM = {0x6E,0xAD,0xCC,0x34,0x9C,0x97,0xE8,0x23,0xED,0x5D,0xA4,0xBB,0xF1,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0xFE,0x7F};
const uint8_t sp2_LIGHT[] PROGMEM = {0x61,0x69,0xC0,0x2B,0x82,0xB3,0xA5,0x79,0x01,0x9A,0x52,0x71,0x57,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0xFC,0x3F};
const uint8_t sp2_IS[] PROGMEM = {0xAD,0xED,0xD5,0x58,0xA4,0x9E,0xCE,0x76,0xF5,0xDD,0xAB,0x29,0xF5,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0xF0,0xFF};

// Male voice SP3 - Numbers and letters

const uint8_t sp3_ZERO[]        PROGMEM = {0x69,0xFB,0x59,0xDD,0x51,0xD5,0xD7,0xB5,0x6F,0x0A,0x78,0xC0,0x52,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0xFF,0x1F};
const uint8_t sp3_ONE[]         PROGMEM = {0x66,0x4E,0xA8,0x7A,0x8D,0xED,0xC4,0xB5,0xCD,0x89,0xD4,0xBC,0xA2,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0xFE,0x1F};
const uint8_t sp3_TWO[]         PROGMEM = {0x06,0xB8,0x59,0x34,0x00,0x27,0xD6,0x38,0x60,0x58,0xD3,0x91,0x55,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0xFF,0x1F};
const uint8_t sp3_THREE[]       PROGMEM = {0x0C,0xE8,0x2E,0x94,0x01,0x4D,0xBA,0x4A,0x40,0x03,0x16,0x68,0x69,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0xFF,0x03};
const uint8_t sp3_FOUR[]        PROGMEM = {0x08,0x68,0x21,0x0D,0x03,0x1C,0x90,0xC0,0x88,0x92,0xB2,0x29,0x87,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0xFC,0x3F};
const uint8_t sp3_FIVE[]        PROGMEM = {0x08,0x68,0x4E,0x9D,0x02,0x1C,0x60,0xC0,0x8C,0x69,0x12,0xB0,0xC0,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0xFF,0x01};
const uint8_t sp3_SIX[]         PROGMEM = {0x04,0xF8,0xB9,0x55,0x01,0xBF,0xA5,0x1B,0xE0,0x37,0x0F,0x03,0xFC,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0xFC,0x3F};
const uint8_t sp3_SEVEN[]       PROGMEM = {0x0C,0x78,0xC6,0x95,0x01,0x3F,0xA5,0x28,0xE0,0xB7,0x52,0x0B,0x04,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0xFF,0x07};
const uint8_t sp3_EIGHT[]       PROGMEM = {0xAD,0x1B,0xDE,0x58,0x23,0x17,0xAF,0x6E,0xE8,0x20,0xEB,0x5C,0xBC,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0xFF,0x0F};
const uint8_t sp3_NINE[]        PROGMEM = {0x62,0x75,0xDC,0x33,0xB5,0x62,0xB9,0x25,0x0B,0x8E,0x34,0x8F,0xD3,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0xFF,0x03};
const uint8_t sp3_TEN[]         PROGMEM = {0x0A,0xD8,0x5C,0x4D,0x03,0x2B,0xAB,0x5E,0xC4,0x33,0x2B,0xAF,0x62,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0xFD,0x7F};
const uint8_t sp3_ELEVEN[]      PROGMEM = {0x29,0x6F,0x52,0xA8,0xBB,0x6A,0x8F,0xBA,0x2B,0xC5,0xE8,0x9C,0xBD,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0xF4,0xFF};
const uint8_t sp3_TWELVE[]      PROGMEM = {0x09,0x98,0xDA,0x22,0x01,0x37,0x78,0x1A,0x20,0x85,0xD1,0x50,0x3A,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0xFE,0x1F};
const uint8_t sp3_THIRTEEN[]    PROGMEM = {0x08,0x18,0xA2,0x12,0x03,0x18,0x40,0xC0,0x50,0x13,0x25,0x1D,0x3A,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0xFC,0x7F};
const uint8_t sp3_FOURTEEN[]    PROGMEM = {0x08,0xE8,0x2A,0x94,0x00,0xC3,0x56,0x10,0x60,0xFA,0x0A,0x01,0x4C,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0xFF,0x0F};
const uint8_t sp3_FIFTEEN[]     PROGMEM = {0x02,0x68,0xD6,0xCC,0x00,0x43,0x9A,0x39,0x60,0x3A,0xF7,0x51,0x34,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0xFF,0x0F};
const uint8_t sp3_SIXTEEN[]     PROGMEM = {0x0C,0x78,0xC6,0x95,0x01,0x3F,0xA5,0x28,0xE0,0xB7,0x52,0x0B,0x04,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0xFF,0x1F};
const uint8_t sp3_SEVENTEEN[]   PROGMEM = {0x0C,0xF8,0x29,0x45,0x01,0xBF,0x95,0x5A,0x20,0x00,0xBF,0xA5,0x3A,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0xFE,0x1F};
const uint8_t sp3_EIGHTEEN[]    PROGMEM = {0x6B,0x18,0x36,0x88,0x3B,0x1B,0xEF,0x61,0x0D,0xD3,0x27,0x52,0xE5,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0xFF,0x01};
const uint8_t sp3_NINETEEN[]    PROGMEM = {0x6E,0x2F,0x44,0xB4,0x5B,0x93,0xA6,0xAD,0x32,0x96,0x2E,0x69,0xBA,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0xFF,0x0F};
const uint8_t sp3_TWENTY[]      PROGMEM = {0x0A,0xE8,0x4A,0xCD,0x01,0xDB,0xB9,0x33,0xC0,0xA6,0x54,0x0C,0xA4,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0xFF,0x1F};
const uint8_t sp3_THIRTY[]      PROGMEM = {0x02,0x18,0xA2,0x52,0x02,0x16,0x60,0xC0,0x50,0x13,0x25,0x6B,0x2C,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0xFF,0x0F};
const uint8_t sp3_FOURTY[]      PROGMEM = {0x04,0xC8,0xCE,0x8C,0x01,0xCB,0x94,0x33,0x60,0xDA,0x0C,0x01,0x0C,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0xFF,0x01};
const uint8_t sp3_FIFTY[]       PROGMEM = {0x08,0x68,0x3A,0x05,0x01,0x5D,0xA4,0x12,0x60,0xD8,0x0A,0x02,0x4C,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0xFD,0xFF};
const uint8_t sp3_SIXTY[]       PROGMEM = {0x06,0x78,0x90,0xC4,0x00,0x3F,0x66,0x18,0xE0,0xA7,0x8C,0x04,0x7C,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0xFF,0x0F};
const uint8_t sp3_SEVENTY[]     PROGMEM = {0x0C,0xF8,0x29,0x45,0x01,0xBF,0x95,0x5A,0x20,0x00,0xBF,0xA5,0x3A,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0xFA,0x7F};
const uint8_t sp3_EIGHTY[]      PROGMEM = {0x63,0xEA,0xD2,0x28,0x37,0x67,0xAD,0x7E,0xF9,0x26,0xAC,0x58,0xB3,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0xFF,0x0F};
const uint8_t sp3_NINETY[]      PROGMEM = {0x6E,0x28,0x1C,0xE3,0x38,0xB4,0xB8,0x3E,0x33,0xAA,0xE5,0xF0,0xB2,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0xFF,0x01};
const uint8_t sp3_HUNDRED[]     PROGMEM = {0x04,0xC8,0x7E,0x5C,0x02,0x0A,0xA8,0x62,0x43,0x03,0xA7,0xA8,0x62,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0xF9,0x7F};
const uint8_t sp3_THOUSAND[]    PROGMEM = {0x08,0x48,0xCC,0x0C,0x01,0x5D,0xA9,0x21,0x60,0x2A,0x33,0x04,0x4C,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0xFE,0x1F};
const uint8_t sp3_MILLION[]     PROGMEM = {0x69,0xCE,0x5C,0x74,0xD4,0x9A,0xF6,0xF1,0xF4,0x83,0x9B,0x98,0xF9,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0xFE,0x1F};

const uint8_t sp3_THE[]         PROGMEM = {0x08,0x20,0xBA,0x0D,0x03,0x69,0xDF,0xA8,0xCD,0x85,0x3B,0xD7,0x79,0xF4,0x59,0xB7,0xA9,0xFA,0xA2,0xD5,0x27,0xD9,0x6E,0x11,0x8B,0xC6,0x90,0xB4,0x47,0xA8,0x6D,0xFA,0x7F};
const uint8_t sp3_TEMPERATURE[] PROGMEM = {0x0A,0x38,0xDE,0x32,0x00,0x2F,0xBB,0x37,0xBF,0x59,0x57,0x76,0x6F,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0xFE,0x1F};
const uint8_t sp3_IS[]          PROGMEM = {0xA3,0xED,0xC6,0x30,0x3D,0x57,0xAD,0x7E,0xA8,0x42,0xA9,0x5C,0xB5,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0xFF,0x07};
const uint8_t sp3_DEGREES[]     PROGMEM = {0x0A,0x28,0x30,0x6C,0x74,0x53,0x25,0xB3,0x67,0xAC,0x95,0x0D,0x63,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0xFE,0x1F};
const uint8_t sp3_CELCIUS[]     PROGMEM = {0x08,0x68,0x48,0x94,0x00,0x37,0x30,0x0A,0xE0,0x0F,0x17,0x05,0xFC,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0xFF,0x07};
const uint8_t spPAUSE2[]        PROGMEM = {0x08,0x14,0xC1,0xDD,0x45,0x64,0x03,0x00,0x00,0x00,0xC0,0xFF,0x4A,0x46,0x51,0x39,0x79,0x15,0x0A};

// NOTIFICATION TONE

const uint8_t spa_TONE1[]     PROGMEM = {0x8D,0xF2,0xDE,0xDD,0xDD,0x93,0x74,0xAA,0x53,0x9D,0xEA,0x54,0xA7,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0x15,0x0A};
const uint8_t spa_TONE2[]     PROGMEM = {0x4D,0xF1,0xDE,0xDD,0xDD,0x93,0x74,0xA5,0x2B,0x5D,0xE9,0x4A,0x57,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0x11,0x5A};

bool leftButtonPressed;
bool rightButtonPressed;

DateTime now;
RTC_DS3231 rtc;
int lightvalue;

void setup() 
{
  Serial.begin(57600);
  CircuitPlayground.begin();
  // Initialize external NeoPixel strip
  strip.begin();
  if (! rtc.begin()) 
  {
    Serial.println("Couldn't find RTC");
    Serial.flush();
    abort();
  }

  if (rtc.lostPower()) 
  {
    Serial.println("RTC lost power, let's set the time!");
    rtc.adjust(DateTime(F(__DATE__), F(__TIME__)));
  }
}
 

void loop() 
{
  now         = rtc.now();
  hour        = now.hour();
  mins        = now.minute();
  sec         = now.second();

  H0_Number = ((hour/10) %10);
  H1_Number = (hour%10);
        
  M0_Number = ((mins/10) %10);
  M1_Number = (mins%10);  
  SS_Number = sec;
  
  Effect_SS();
   
  Effect_M0(_GREEN);
  Effect_M1(_RED);
    
  Effect_H0(_BLUE);
  Effect_H1(_PURPLE);

  Effect_SEP(_BLACK);
  Effect_Speech();
}

void DrawDot(byte number, byte coordinates[], byte maximum, uint32_t frontcolor)
{ 
  for(int i=0; i< number; i++)
  {
    strip.setPixelColor(coordinates[i], frontcolor);
    strip.show();        
  }
  if((number==0))
  {
    for(int i=0; i< maximum; i++)
    {
      strip.setPixelColor(coordinates[i], _BLACK);
      strip.show();
    }
  } 
}

void Effect_M1(uint32_t frontcolor)
{ 
  if ( (unsigned long) (micros() - samplingtimem1) > 555  )
  {     
    m1 = M1_Number;
    if (m1 != prvem1)  
      {      
        DrawDot(M1_Number, M1, 9, frontcolor);            
        prvem1 = m1;
      }
      samplingtimem1 = micros(); 
    }
}   

void Effect_M0(uint32_t frontcolor)
{ 
  if ( (unsigned long) (micros() - samplingtimem0) > 655  )
  {
    m0 = M0_Number;
    if (m0!=prvem0)  
      {         
        DrawDot(M0_Number, M0, 5, frontcolor);  
        prvem0 = m0;
      }
      samplingtimem0 = micros(); 
    }
} 

void Effect_H1(uint32_t frontcolor)
{ 
  if ( (unsigned long) (micros() - samplingtimeh1) > 755  )
  {

    h1 = H1_Number;
    if (h1 != prveh1)  
      {          
        DrawDot(H1_Number, H1, 9, frontcolor); 
        prveh1 = h1;
      }
      samplingtimeh1 = micros(); 
    }
}       

void Effect_H0(uint32_t frontcolor)
{ 
  if ( (unsigned long) (micros() - samplingtimeh0) > 855  )
  {    
    h0 = H0_Number;    
    if (h0 != prveh0)  
      {   
        DrawDot(H0_Number, H0, 5, frontcolor); 
        prveh0 = h0;
      }
      samplingtimeh0 = micros(); 
    }
}

// Separator dots

void Effect_SEP(uint32_t frontcolor)
{ 
  if ( (unsigned long) (micros() - samplingtimese) > 999  )  
    DrawDot(7, SEPERATOR, 7, frontcolor); 
    samplingtimese = micros(); 
 }

// Built-in NeoPixel leds change color in every second

void Effect_SS()
{
  if ( (unsigned long) (micros() - samplingtimess) > 455  )
  {    
    ss = SS_Number;    
    if (ss != prvess)  
      { 
      for (int pixel=0; pixel< IN_NUM_PIXELS; pixel++)
        {
          CircuitPlayground.setPixelColor(pixel, colors[SS_Number%10]);
        }
      prvess = ss;
      }
    samplingtimess = micros();
  }
}

void Effect_Speech()
{
if ( (unsigned long) (micros() - samplingtimesp) > 355  )
  {  
  leftButtonPressed = CircuitPlayground.leftButton();
  rightButtonPressed = CircuitPlayground.rightButton();
  
  // TIME SPEAKING  
  if (leftButtonPressed) 
  {
    CircuitPlayground.speaker.say(spa_TONE1);
    CircuitPlayground.speaker.say(spPAUSE2);
    CircuitPlayground.speaker.say(spTHE);
    CircuitPlayground.speaker.say(spTIME);
    CircuitPlayground.speaker.say(spIS);
    CircuitPlayground.speaker.say(spPAUSE1);
    
    switch (now.twelveHour())
      { 
        case 1: CircuitPlayground.speaker.say(spONE);                                             break;
        case 2: CircuitPlayground.speaker.say(spTWO);                                             break;
        case 3: CircuitPlayground.speaker.say(spTHREE);                                           break;
        case 4: CircuitPlayground.speaker.say(spFOUR);                                            break;
        case 5: CircuitPlayground.speaker.say(spFIVE);                                            break;
        case 6: CircuitPlayground.speaker.say(spSIX);                                             break;
        case 7: CircuitPlayground.speaker.say(spSEVEN);                                           break;
        case 8: CircuitPlayground.speaker.say(spEIGHT);                                           break;
        case 9: CircuitPlayground.speaker.say(spNINE);                                            break;
        case 10: CircuitPlayground.speaker.say(spTEN);                                            break;
        case 11: CircuitPlayground.speaker.say(spELEVEN);                                         break;
        case 12: CircuitPlayground.speaker.say(spTWELVE);                                         break;
      }  
    
    CircuitPlayground.speaker.say(spPAUSE1);
    
    switch (now.minute())
      {
        case 1: CircuitPlayground.speaker.say(spONE);                                             break;
        case 2: CircuitPlayground.speaker.say(spTWO);                                             break;
        case 3: CircuitPlayground.speaker.say(spTHREE);                                           break;
        case 4: CircuitPlayground.speaker.say(spFOUR);                                            break;
        case 5: CircuitPlayground.speaker.say(spFIVE);                                            break;
        case 6: CircuitPlayground.speaker.say(spSIX);                                             break;
        case 7: CircuitPlayground.speaker.say(spSEVEN);                                           break;
        case 8: CircuitPlayground.speaker.say(spEIGHT);                                           break;
        case 9: CircuitPlayground.speaker.say(spNINE);                                            break;
        case 10: CircuitPlayground.speaker.say(spTEN);                                            break;
        case 11: CircuitPlayground.speaker.say(spELEVEN);                                         break;
        case 12: CircuitPlayground.speaker.say(spTWELVE);                                         break;
        case 13: CircuitPlayground.speaker.say(spTHIRTEEN);                                       break;
        case 14: CircuitPlayground.speaker.say(spFOURTEEN);                                       break;
        case 15: CircuitPlayground.speaker.say(spFIFTEEN);                                        break;
        case 16: CircuitPlayground.speaker.say(spSIXTEEN);                                        break;
        case 17: CircuitPlayground.speaker.say(spSEVENTEEN);                                      break;
        case 18: CircuitPlayground.speaker.say(spEIGHTEEN);                                       break;
        case 19: CircuitPlayground.speaker.say(spNINETEEN);                                       break;
        case 20: CircuitPlayground.speaker.say(spTWENTY);                                         break;
        case 21: CircuitPlayground.speaker.say(spTWENTY); CircuitPlayground.speaker.say(spONE);   break;
        case 22: CircuitPlayground.speaker.say(spTWENTY); CircuitPlayground.speaker.say(spTWO);   break;
        case 23: CircuitPlayground.speaker.say(spTWENTY); CircuitPlayground.speaker.say(spTHREE); break;
        case 24: CircuitPlayground.speaker.say(spTWENTY); CircuitPlayground.speaker.say(spFOUR);  break;
        case 25: CircuitPlayground.speaker.say(spTWENTY); CircuitPlayground.speaker.say(spFIVE);  break;
        case 26: CircuitPlayground.speaker.say(spTWENTY); CircuitPlayground.speaker.say(spSIX);   break;
        case 27: CircuitPlayground.speaker.say(spTWENTY); CircuitPlayground.speaker.say(spSEVEN); break;
        case 28: CircuitPlayground.speaker.say(spTWENTY); CircuitPlayground.speaker.say(spEIGHT); break;
        case 29: CircuitPlayground.speaker.say(spTWENTY); CircuitPlayground.speaker.say(spNINE);  break;
        case 30: CircuitPlayground.speaker.say(spTHIRTY);                                         break;
        case 31: CircuitPlayground.speaker.say(spTHIRTY); CircuitPlayground.speaker.say(spONE);   break;
        case 32: CircuitPlayground.speaker.say(spTHIRTY); CircuitPlayground.speaker.say(spTWO);   break;
        case 33: CircuitPlayground.speaker.say(spTHIRTY); CircuitPlayground.speaker.say(spTHREE); break;
        case 34: CircuitPlayground.speaker.say(spTHIRTY); CircuitPlayground.speaker.say(spFOUR);  break;
        case 35: CircuitPlayground.speaker.say(spTHIRTY); CircuitPlayground.speaker.say(spFIVE);  break;
        case 36: CircuitPlayground.speaker.say(spTHIRTY); CircuitPlayground.speaker.say(spSIX);   break;
        case 37: CircuitPlayground.speaker.say(spTHIRTY); CircuitPlayground.speaker.say(spSEVEN); break;
        case 38: CircuitPlayground.speaker.say(spTHIRTY); CircuitPlayground.speaker.say(spEIGHT); break;
        case 39: CircuitPlayground.speaker.say(spTHIRTY); CircuitPlayground.speaker.say(spNINE);  break;
        case 40: CircuitPlayground.speaker.say(spFOURTY);                                         break;
        case 41: CircuitPlayground.speaker.say(spFOURTY); CircuitPlayground.speaker.say(spONE);   break;
        case 42: CircuitPlayground.speaker.say(spFOURTY); CircuitPlayground.speaker.say(spTWO);   break;
        case 43: CircuitPlayground.speaker.say(spFOURTY); CircuitPlayground.speaker.say(spTHREE); break;
        case 44: CircuitPlayground.speaker.say(spFOURTY); CircuitPlayground.speaker.say(spFOUR);  break;
        case 45: CircuitPlayground.speaker.say(spFOURTY); CircuitPlayground.speaker.say(spFIVE);  break;
        case 46: CircuitPlayground.speaker.say(spFOURTY); CircuitPlayground.speaker.say(spSIX);   break;
        case 47: CircuitPlayground.speaker.say(spFOURTY); CircuitPlayground.speaker.say(spSEVEN); break;
        case 48: CircuitPlayground.speaker.say(spFOURTY); CircuitPlayground.speaker.say(spEIGHT); break;
        case 49: CircuitPlayground.speaker.say(spFOURTY); CircuitPlayground.speaker.say(spNINE);  break;
        case 50: CircuitPlayground.speaker.say(spFIFTY);                                          break;
        case 51: CircuitPlayground.speaker.say(spFIFTY);  CircuitPlayground.speaker.say(spONE);   break;
        case 52: CircuitPlayground.speaker.say(spFIFTY);  CircuitPlayground.speaker.say(spTWO);   break;
        case 53: CircuitPlayground.speaker.say(spFIFTY);  CircuitPlayground.speaker.say(spTHREE); break;
        case 54: CircuitPlayground.speaker.say(spFIFTY);  CircuitPlayground.speaker.say(spFOUR);  break;
        case 55: CircuitPlayground.speaker.say(spFIFTY);  CircuitPlayground.speaker.say(spFIVE);  break;
        case 56: CircuitPlayground.speaker.say(spFIFTY);  CircuitPlayground.speaker.say(spSIX);   break;
        case 57: CircuitPlayground.speaker.say(spFIFTY);  CircuitPlayground.speaker.say(spSEVEN); break;
        case 58: CircuitPlayground.speaker.say(spFIFTY);  CircuitPlayground.speaker.say(spEIGHT); break;
        case 59: CircuitPlayground.speaker.say(spFIFTY);  CircuitPlayground.speaker.say(spNINE);  break;      
      }
    
    CircuitPlayground.speaker.say(spPAUSE1);
    
    if (now.isPM()) 
      {
        CircuitPlayground.speaker.say(spP_M_);
      }
      else 
      {
        CircuitPlayground.speaker.say(spA_M_);
      }

    CircuitPlayground.speaker.say(spa_TONE1);
    CircuitPlayground.speaker.end();
  }
    
// TEMPERATURE SPEAKING

  else if (rightButtonPressed)
  {    
    CircuitPlayground.speaker.say(spa_TONE2);
    CircuitPlayground.speaker.say(spPAUSE2);
    CircuitPlayground.speaker.say(sp3_THE);
    CircuitPlayground.speaker.say(sp3_TEMPERATURE);
    CircuitPlayground.speaker.say(sp3_IS);
    CircuitPlayground.speaker.say(spPAUSE2);
    
    switch ((int)rtc.getTemperature())
      {
        case 0: CircuitPlayground.speaker.say(sp3_ZERO);                                              break;
        case 1: CircuitPlayground.speaker.say(sp3_ONE);                                               break;
        case 2: CircuitPlayground.speaker.say(sp3_TWO);                                               break;
        case 3: CircuitPlayground.speaker.say(sp3_THREE);                                             break;
        case 4: CircuitPlayground.speaker.say(sp3_FOUR);                                              break;
        case 5: CircuitPlayground.speaker.say(sp3_FIVE);                                              break;
        case 6: CircuitPlayground.speaker.say(sp3_SIX);                                               break;
        case 7: CircuitPlayground.speaker.say(sp3_SEVEN);                                             break;
        case 8: CircuitPlayground.speaker.say(sp3_EIGHT);                                             break;
        case 9: CircuitPlayground.speaker.say(sp3_NINE);                                              break;
        case 10: CircuitPlayground.speaker.say(sp3_TEN);                                              break;
        case 11: CircuitPlayground.speaker.say(sp3_ELEVEN);                                           break;
        case 12: CircuitPlayground.speaker.say(sp3_TWELVE);                                           break;
        case 13: CircuitPlayground.speaker.say(sp3_THIRTEEN);                                         break;
        case 14: CircuitPlayground.speaker.say(sp3_FOURTEEN);                                         break;
        case 15: CircuitPlayground.speaker.say(sp3_FIFTEEN);                                          break;
        case 16: CircuitPlayground.speaker.say(sp3_SIXTEEN);                                          break;
        case 17: CircuitPlayground.speaker.say(sp3_SEVENTEEN);                                        break;
        case 18: CircuitPlayground.speaker.say(sp3_EIGHTEEN);                                         break;
        case 19: CircuitPlayground.speaker.say(sp3_NINETEEN);                                         break;
        case 20: CircuitPlayground.speaker.say(sp3_TWENTY);                                           break;
        case 21: CircuitPlayground.speaker.say(sp3_TWENTY); CircuitPlayground.speaker.say(sp3_ONE);   break;
        case 22: CircuitPlayground.speaker.say(sp3_TWENTY); CircuitPlayground.speaker.say(sp3_TWO);   break;
        case 23: CircuitPlayground.speaker.say(sp3_TWENTY); CircuitPlayground.speaker.say(sp3_THREE); break;
        case 24: CircuitPlayground.speaker.say(sp3_TWENTY); CircuitPlayground.speaker.say(sp3_FOUR);  break;
        case 25: CircuitPlayground.speaker.say(sp3_TWENTY); CircuitPlayground.speaker.say(sp3_FIVE);  break;
        case 26: CircuitPlayground.speaker.say(sp3_TWENTY); CircuitPlayground.speaker.say(sp3_SIX);   break;
        case 27: CircuitPlayground.speaker.say(sp3_TWENTY); CircuitPlayground.speaker.say(sp3_SEVEN); break;
        case 28: CircuitPlayground.speaker.say(sp3_TWENTY); CircuitPlayground.speaker.say(sp3_EIGHT); break;
        case 29: CircuitPlayground.speaker.say(sp3_TWENTY); CircuitPlayground.speaker.say(sp3_NINE);  break;
        case 30: CircuitPlayground.speaker.say(sp3_THIRTY);                                           break;
        case 31: CircuitPlayground.speaker.say(sp3_THIRTY); CircuitPlayground.speaker.say(sp3_ONE);   break;
        case 32: CircuitPlayground.speaker.say(sp3_THIRTY); CircuitPlayground.speaker.say(sp3_TWO);   break;
        case 33: CircuitPlayground.speaker.say(sp3_THIRTY); CircuitPlayground.speaker.say(sp3_THREE); break;
        case 34: CircuitPlayground.speaker.say(sp3_THIRTY); CircuitPlayground.speaker.say(sp3_FOUR);  break;
        case 35: CircuitPlayground.speaker.say(sp3_THIRTY); CircuitPlayground.speaker.say(sp3_FIVE);  break;
        case 36: CircuitPlayground.speaker.say(sp3_THIRTY); CircuitPlayground.speaker.say(sp3_SIX);   break;
        case 37: CircuitPlayground.speaker.say(sp3_THIRTY); CircuitPlayground.speaker.say(sp3_SEVEN); break;
        case 38: CircuitPlayground.speaker.say(sp3_THIRTY); CircuitPlayground.speaker.say(sp3_EIGHT); break;
        case 39: CircuitPlayground.speaker.say(sp3_THIRTY); CircuitPlayground.speaker.say(sp3_NINE);  break;
        case 40: CircuitPlayground.speaker.say(sp3_FOURTY);                                           break;
        case 41: CircuitPlayground.speaker.say(sp3_FOURTY); CircuitPlayground.speaker.say(sp3_ONE);   break;
        case 42: CircuitPlayground.speaker.say(sp3_FOURTY); CircuitPlayground.speaker.say(sp3_TWO);   break;
        case 43: CircuitPlayground.speaker.say(sp3_FOURTY); CircuitPlayground.speaker.say(sp3_THREE); break;
        case 44: CircuitPlayground.speaker.say(sp3_FOURTY); CircuitPlayground.speaker.say(sp3_FOUR);  break;
        case 45: CircuitPlayground.speaker.say(sp3_FOURTY); CircuitPlayground.speaker.say(sp3_FIVE);  break;
        case 46: CircuitPlayground.speaker.say(sp3_FOURTY); CircuitPlayground.speaker.say(sp3_SIX);   break;
        case 47: CircuitPlayground.speaker.say(sp3_FOURTY); CircuitPlayground.speaker.say(sp3_SEVEN); break;
        case 48: CircuitPlayground.speaker.say(sp3_FOURTY); CircuitPlayground.speaker.say(sp3_EIGHT); break;
        case 49: CircuitPlayground.speaker.say(sp3_FOURTY); CircuitPlayground.speaker.say(sp3_NINE);  break;
        case 50: CircuitPlayground.speaker.say(sp3_FIFTY);                                            break;
        case 51: CircuitPlayground.speaker.say(sp3_FIFTY);  CircuitPlayground.speaker.say(sp3_ONE);   break;
        case 52: CircuitPlayground.speaker.say(sp3_FIFTY);  CircuitPlayground.speaker.say(sp3_TWO);   break;
        case 53: CircuitPlayground.speaker.say(sp3_FIFTY);  CircuitPlayground.speaker.say(sp3_THREE); break;
        case 54: CircuitPlayground.speaker.say(sp3_FIFTY);  CircuitPlayground.speaker.say(sp3_FOUR);  break;
        case 55: CircuitPlayground.speaker.say(sp3_FIFTY);  CircuitPlayground.speaker.say(sp3_FIVE);  break;
        case 56: CircuitPlayground.speaker.say(sp3_FIFTY);  CircuitPlayground.speaker.say(sp3_SIX);   break;
        case 57: CircuitPlayground.speaker.say(sp3_FIFTY);  CircuitPlayground.speaker.say(sp3_SEVEN); break;
        case 58: CircuitPlayground.speaker.say(sp3_FIFTY);  CircuitPlayground.speaker.say(sp3_EIGHT); break;
        case 59: CircuitPlayground.speaker.say(sp3_FIFTY);  CircuitPlayground.speaker.say(sp3_NINE);  break;
      }

      CircuitPlayground.speaker.say(spPAUSE2);
      CircuitPlayground.speaker.say(sp3_DEGREES);
      CircuitPlayground.speaker.say(sp3_CELCIUS);
      
    CircuitPlayground.speaker.say(spa_TONE1);
    CircuitPlayground.speaker.end();
  }
  else
  {
    
  }
  samplingtimesp = micros();
  }
}
